## conf/layer.conf
```bitbake
# We have a conf and classes directory, add to BBPATH
BBPATH .= ":${LAYERDIR}"

# We have recipes-* directories, add to BBFILES
BBFILES += "${LAYERDIR}/recipes-*/*/*.bb \
	${LAYERDIR}/recipes-*/*/*.bbappend"

BBFILE_COLLECTIONS += "update"
BBFILE_PATTERN_update = "^${LAYERDIR}/"
BBFILE_PRIORITY_update = "6"

# meta-python is needed to build/run update-server
LAYERRECOMMENDS_update = "meta-python"

LAYERSERIES_COMPAT_update = "dunfell zeus"
```
